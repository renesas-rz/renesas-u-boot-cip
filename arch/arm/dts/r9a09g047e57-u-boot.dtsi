// SPDX-License-Identifier: GPL-2.0
/*
 * RZ/G3E (R9A09G047E57) SoC, specific setting for u-boot
 *
 * Copyright (C) 2024 Renesas Electronics Corp.
 */

/* Include the base U-Boot overlay for RZ/G3E */
#include "r9a09g047-u-boot.dtsi"
