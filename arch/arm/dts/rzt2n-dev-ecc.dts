// SPDX-License-Identifier: (GPL-2.0-only OR BSD-2-Clause)
/*
 * Device Tree Source for the RZ/T2N Development EVK board
 *
 * Copyright (C) 2024 Renesas Electronics Corp.
 */

#include "rzt2n-dev.dts"

&memory1 {
	reg = <0x2 0x40000000 0x0 0x30000000>;
};
