// SPDX-License-Identifier: GPL-2.0
/*
 * Device Tree Source extras for U-Boot on R8A774E1 SoC
 *
 * Copyright (C) 2019 Marek Vasut <marek.vasut@gmail.com>
 */

#include "r8a779x-u-boot.dtsi"

&extalr_clk {
	u-boot,dm-pre-reloc;
};
