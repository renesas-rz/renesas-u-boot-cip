// SPDX-License-Identifier: GPL-2.0
/*
 * Device Tree Source extras for U-Boot on RZV2M r9a09g011gbg
 *
 * Copyright (C) 2018 Marek Vasut <marek.vasut@gmail.com>
 */

#include "rzv2m-rzv2ma-u-boot-extra.dtsi"
