## configs/smarc-rzf_defconfig
```kconfig
# configuration of RISC-V
CONFIG_RISCV=y
CONFIG_ARCH_RV64I=y
CONFIG_RISCV_SMODE=y
CONFIG_CACHE=y
CONFIG_RISCV_NDS_CACHE=y
CONFIG_V5L2_CACHE=y
CONFIG_TARGET_SMARC_RZF=y
CONFIG_RZF_DEV=y
CONFIG_DEFAULT_DEVICE_TREE="smarc-rzf"
CONFIG_DEFAULT_FDT_FILE="smarc-rzf.dtb"
CONFIG_RISCV_RDTIME=y
# configuration of U-BOOT
CONFIG_TEXT_BASE=0x50000000
CONFIG_SYS_MALLOC_F_LEN=0x2000
CONFIG_BOARD_EARLY_INIT_F=y
CONFIG_BOARD_LATE_INIT=y
CONFIG_SPL_FRAMEWORK_BOARD_INIT_F=n
CONFIG_HAS_CUSTOM_SYS_INIT_SP_ADDR=y
CONFIG_CUSTOM_SYS_INIT_SP_ADDR=0x4ffffe70
CONFIG_FIT=y
CONFIG_OF_BOARD_SETUP=y
CONFIG_HAVE_BLOCK_DEVICE=y
CONFIG_REGMAP=y
CONFIG_SYSCON=y
CONFIG_HUSH_PARSER=y
CONFIG_VERSION_VARIABLE=y
CONFIG_DISPLAY_BOARDINFO=y
CONFIG_DISPLAY_CPUINFO=y
CONFIG_ENV_SIZE=0x20000
CONFIG_ENV_OFFSET=0xFFFE0000
CONFIG_ENV_IS_IN_MMC=y
CONFIG_SYS_MMC_ENV_DEV=0
CONFIG_SYS_MMC_ENV_PART=2
CONFIG_ENV_OVERWRITE=y
CONFIG_SYS_RELOC_GD_ENV_ADDR=y
CONFIG_DISTRO_DEFAULTS=y
CONFIG_SUPPORT_RAW_INITRD=y
CONFIG_SYS_MONITOR_BASE=0x00000000
CONFIG_USE_BOOTARGS=y
CONFIG_USE_BOOTCOMMAND=y
CONFIG_BOOTARGS="root=/dev/nfs rw nfsroot=192.168.0.1:/export/rfs ip=192.168.0.20"
CONFIG_BOOTCOMMAND="ext4load mmc 1:1 0x48080000 Image;ext4load mmc 1:1 0x48000000 "CONFIG_DEFAULT_FDT_FILE";booti 0x48080000 - 0x48000000"
CONFIG_SYS_MALLOC_BOOTPARAMS=y
CONFIG_SMBIOS_MANUFACTURER=""
CONFIG_SMBIOS_PRODUCT_NAME=""
# configuration of OF
CONFIG_OF_CONTROL=y
CONFIG_OF_DTB_PROPS_REMOVE=y
CONFIG_OF_REMOVE_PROPS="dmas dma-names interrupt-parent interrupts interrupts-extended interrupt-names interrupt-map interrupt-map-mask iommus"
CONFIG_OF_SEPARATE=y
CONFIG_OF_LIST="smarc-rzf"
CONFIG_OF_LIBFDT_OVERLAY=y
# configuration of driver
CONFIG_CLK=y
CONFIG_CLK_R9A07G043F=y
CONFIG_DM_GPIO=y
CONFIG_RZG2L_GPIO=y
CONFIG_PINCTRL=y
CONFIG_PINCTRL_PFC=y
CONFIG_PINCTRL_PFC_RZG2L=y
CONFIG_DM_I2C=y
CONFIG_SYS_I2C_RZG2L_RIIC=y
CONFIG_SH_SDHI=y
CONFIG_BITBANGMII=y
CONFIG_PHY_MICREL=y
CONFIG_PHY_MICREL_KSZ90X1=y
CONFIG_RENESAS_RAVB=y
CONFIG_DM_REGULATOR=y
CONFIG_DM_REGULATOR_FIXED=y
CONFIG_DM_REGULATOR_GPIO=y
CONFIG_SCIF_CONSOLE=y
CONFIG_USB=y
CONFIG_USB_XHCI_HCD=y
CONFIG_USB_EHCI_HCD=y
CONFIG_USB_EHCI_GENERIC=y
CONFIG_USB_STORAGE=y
CONFIG_MMC=y
CONFIG_SUPPORT_EMMC_RPMB=y
CONFIG_SUPPORT_EMMC_BOOT=y
CONFIG_PHY=y
CONFIG_BLK=y
CONFIG_WDT=y
CONFIG_RENESAS_RZG2LWDT=y
# configuration of SPL
CONFIG_SPL=y
CONFIG_SPL_CLK=y
CONFIG_SPL_CACHE=y
CONFIG_SPL_CACHE_SUPPORT=y
CONFIG_SPL_CPU_SUPPORT=y
CONFIG_SPL_SMP=n
CONFIG_SPL_SEPARATE_BSS=y
CONFIG_SPL_FIT=y
CONFIG_SPL_LOAD_FIT=y
CONFIG_SPL_OF_CONTROL=y
CONFIG_SPL_OF_LIST="rzv-dev_ddr4"
CONFIG_SPL_DM=y
CONFIG_SPL_DM_SERIAL=y
CONFIG_SPL_NOR_SUPPORT=y
CONFIG_SPL_BLK=y
CONFIG_SPL_MMC=y
CONFIG_SYS_MMCSD_RAW_MODE_U_BOOT_USE_SECTOR=y
CONFIG_SYS_MMCSD_RAW_MODE_U_BOOT_SECTOR=0x100
CONFIG_SPL_HAS_BSS_LINKER_SECTION=y
CONFIG_SYS_LOAD_ADDR=0x58000000
CONFIG_SYS_MAXARGS=64
CONFIG_SYS_PBSIZE=2068
CONFIG_SYS_CBSIZE=2048
CONFIG_SPL_BSS_START_ADDR=0x48000000
# CONFIG_SPL_SHARES_INIT_SP_ADDR is not set
CONFIG_SPL_STACK=0x30000
CONFIG_SYS_SPL_MALLOC=y
CONFIG_SYS_SPL_MALLOC_SIZE=0x200000
CONFIG_SPL_MAX_SIZE=0x00013000
CONFIG_SYS_BARGSIZE=2048
CONFIG_SPL_BSS_MAX_SIZE=0x100000
CONFIG_SYS_MALLOC_LEN=0x8000000
CONFIG_SYS_BOOTM_LEN=0x4000000
# configuration of CMD
CONFIG_CMD_BOOTZ=y
CONFIG_CMD_GPIO=y
CONFIG_CMD_I2C=y
CONFIG_CMD_MMC=y
CONFIG_CMD_USB=y
CONFIG_CMD_DHCP=y
CONFIG_CMD_MII=y
CONFIG_CMD_PING=y
CONFIG_CMD_EXT2=y
CONFIG_CMD_EXT4=y
CONFIG_CMD_EXT4_WRITE=y
CONFIG_CMD_FAT=y
CONFIG_CMD_FS_GENERIC=y
CONFIG_CMD_SBI=y
CONFIG_CMD_WDT=y
# configuration of DDR settings
#CONFIG_RZF_DDR_C_010_D3_02_2=y
#CONFIG_RZF_DDR_C_010_D4_01_1=y
#CONFIG_RZF_DDR_C_010_D4_01_2=y
#CONFIG_RZF_DDR_C_011_D3_01_2=y
#CONFIG_RZF_DDR_C_011_D4_01_1=y
CONFIG_RZF_DDR_C_011_D4_01_2=y
#CONFIG_RZF_DDR_SWIZZLE_T1BC=y
#CONFIG_RZF_DDR_SWIZZLE_T1C=y
#CONFIG_RZF_DDR_SWIZZLE_T2C=y
#CONFIG_RZF_DDR_SWIZZLE_T3BC=y
#CONFIG_RZF_DDR_SWIZZLE_T3BCUD=y
CONFIG_RZF_DDR_SWIZZLE_T3BCUD2=y
#CONFIG_RZF_DDR_SWIZZLE_T3BCUL=y
#CONFIG_RZF_DDR_SWIZZLE_T3CL=y
CONFIG_RZF_DDR_PLL4=1600
#CONFIG_RZF_DDR_PLL4=1333
CONFIG_RZF_DDR_SIZE=0x40000000
# configuration of OpenSBI debug
CONFIG_DEBUG_OPENSBI=y
CONFIG_SBI_V02=y
CONFIG_CMD_EXCEPTION=y
CONFIG_SPI_FLASH=y
CONFIG_SPI_FLASH_BAR=y
CONFIG_SPI_FLASH_USE_4K_SECTORS=y
CONFIG_SPI=y
CONFIG_DM_SPI=y
CONFIG_SPI_FLASH_WINBOND=y
CONFIG_RENESAS_RPC_SPI=y
CONFIG_CMD_SF=y
CONFIG_CMD_SPI=y
CONFIG_SPI_FLASH_STMICRO=y
CONFIG_DM_SPI_FLASH=y
```

## drivers/phy/renesas/Kconfig
```kconfig
# SPDX-License-Identifier: GPL-2.0
#
# Phy drivers for Renesas platforms

config PHY_R8A779F0_ETHERNET_SERDES
	tristate "Renesas R-Car S4-8 Ethernet SERDES driver"
	depends on RCAR_64 && PHY
	help
	  Support for Ethernet SERDES found on Renesas R-Car S4-8 SoCs.
	
config PHY_RZT2H_USB2
    bool "Support for Renesas RZ/T2H USB2 PHY"
    depends on RZT2H

config PHY_RZN2H_USB2
    bool "Support for Renesas RZ/N2H USB2 PHY"
    depends on RZN2H
```
