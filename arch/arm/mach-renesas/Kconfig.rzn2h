## arch/arm/mach-renesas/Kconfig.rzn2h
```kconfig
# Copyright (C) 2023 Renesas Electronics Corporation
# SPDX-License-Identifier: GPL-2.0+

if RZN2H

config R9A09G087
	bool "Renesas R9A09G087 SoC"
	help
	  Enable support for the Renesas R9A09G087 (RZ/N2H) SoC.

choice
	prompt "Renesas RZ/N2H Family Board selection"
	optional

config TARGET_RZN2H_DEV
	bool "Renesas RZ/N2H DEV"
	imply R9A09G087
	help
	  Enable support for the RZ/N2H evaluation board.

endchoice

source "board/renesas/rzn2h-dev/Kconfig"

config MULTI_DTB_FIT_UNCOMPRESS_SZ
	default 0x80000 if TARGET_SMARC_RZT2H
	default 0x80000 if TARGET_RZN2H_DEV

endif
```

## arch/arm/mach-renesas/Kconfig.rzt2h
```kconfig
# Copyright (C) 2023 Renesas Electronics Corporation
# SPDX-License-Identifier: GPL-2.0+

if RZT2H

config R9A09G077
	bool "Renesas R9A09G077 SoC"
	help
	  Enable support for the Renesas R9A09G077 (RZ/T2H) SoC.

choice
	prompt "Renesas RZ/T2H Family Board selection"
	optional

config TARGET_RZT2H_DEV
	bool "Renesas RZ/T2H DEV"
	imply R9A09G077
	help
	  Enable support for the RZ/T2H evaluation board.

endchoice

source "board/renesas/rzt2h-dev/Kconfig"

config MULTI_DTB_FIT_UNCOMPRESS_SZ
	default 0x80000 if TARGET_SMARC_RZT2H
	default 0x80000 if TARGET_RZT2H_DEV

endif
```

## arch/arm/mach-renesas/Kconfig.rzt2n
```kconfig
# Copyright (C) 2023 Renesas Electronics Corporation
# SPDX-License-Identifier: GPL-2.0+

if RZT2N

config R9A07G076
	bool "Renesas R9A07G076 SoC"
	help
	  Enable support for the Renesas R9A07G076 (RZ/T2N) SoC.

choice
	prompt "Renesas RZ/T2N Family Board selection"
	optional

config TARGET_RZT2N_DEV
	bool "Renesas RZ/T2N DEV"
	imply R9A07G076
	help
	  Enable support for the RZ/T2N evaluation board.
endchoice

config TARGET_RZT2N_537_PIN_DEV
	bool "Renesas RZ/T2N DEV for 537 pin device"
	help
	  Enable support for the RZ/T2N evaluation board.

source "board/renesas/rzt2n-dev/Kconfig"

config MULTI_DTB_FIT_UNCOMPRESS_SZ
	default 0x80000 if TARGET_RZT2N_DEV

endif
```

## board/renesas/rzg3l-dev/Kconfig
```kconfig
if TARGET_RZG3L_DEV

config SYS_SOC
	default "renesas"

config SYS_BOARD
	default "rzg3l-dev"

config SYS_VENDOR
	default "renesas"

config SYS_CONFIG_NAME
	default "rzg3l-dev"

endif

if TARGET_SMARC_RZG3L

config SYS_SOC
	default "renesas"

config SYS_BOARD
	default "rzg3l-dev"

config SYS_VENDOR
	default "renesas"

config SYS_CONFIG_NAME
	default "smarc-rzg3l"

endif
```

## board/renesas/rzn2h-dev/Kconfig
```kconfig
if TARGET_RZN2H_DEV

config SYS_SOC
	default "rmobile"

config SYS_BOARD
	default "rzn2h-dev"

config SYS_VENDOR
	default "renesas"

config SYS_CONFIG_NAME
	default "rzn2h-dev"

config SERIAL_SH_RSCI
	bool "Renesas serial driver for RSCI port"

endif
```

## board/renesas/rzt2h-dev/Kconfig
```kconfig
if TARGET_RZT2H_DEV

config SYS_SOC
	default "rmobile"

config SYS_BOARD
	default "rzt2h-dev"

config SYS_VENDOR
	default "renesas"

config SYS_CONFIG_NAME
	default "rzt2h-dev"

config SERIAL_SH_RSCI
	bool "Renesas serial driver for RSCI port"

endif
```

## board/renesas/rzt2n-dev/Kconfig
```kconfig
if TARGET_RZT2N_DEV

config SYS_SOC
	default "renesas"

config SYS_BOARD
	default "rzt2n-dev"

config SYS_VENDOR
	default "renesas"

config SYS_CONFIG_NAME
	default "rzt2n-dev"

endif
```

## configs/rzn2h-dev_defconfig
```kconfig
#new
CONFIG_OF_UPSTREAM=n
CONFIG_SYS_CACHE_SHIFT_6=n #arch/arm/kconfig arm64 forces SHIFT_6
CONFIG_BOOTMETH_EFI_BOOTMGR=n
CONFIG_LAST_STAGE_INIT=n
CONFIG_DM_WARN=y
CONFIG_SMBIOS=n
CONFIG_EFI_BINARY_EXEC=n



CONFIG_MTD=y
CONFIG_MULTI_DTB_FIT_UNCOMPRESS_SZ=0x8000

CONFIG_RZN2H=y
CONFIG_PINCTRL_PFC_RZT2H=y
CONFIG_RZT2H_GPIO=y
CONFIG_ARM=y
CONFIG_ARCH_CPU_INIT=y
CONFIG_ARCH_RENESAS=y
CONFIG_TEXT_BASE=0xc4000000
CONFIG_ENV_SIZE=0x20000
CONFIG_ENV_OFFSET=0x3FFFE0000
CONFIG_SYS_LOAD_ADDR=0xC4200000
CONFIG_BOARD_SIZE_LIMIT=2097152
CONFIG_DM_GPIO=y

CONFIG_TARGET_RZN2H_DEV=y
CONFIG_DEFAULT_DEVICE_TREE="rzn2h-dev"
CONFIG_SMBIOS_PRODUCT_NAME=""
CONFIG_SPL=n
CONFIG_FIT=y
CONFIG_USE_BOOTARGS=y
CONFIG_BOOTARGS="rw rootwait earlycon root=/dev/mmcblk0p1"
CONFIG_SUPPORT_RAW_INITRD=y
CONFIG_DEFAULT_FDT_FILE="rzn2h-dev.dtb"
CONFIG_VERSION_VARIABLE=y
CONFIG_HUSH_PARSER=y
CONFIG_CMD_BOOTZ=y
CONFIG_CMD_GPIO=y
CONFIG_CMD_I2C=y
CONFIG_CMD_MMC=y
CONFIG_CMD_PCI=y
CONFIG_CMD_USB=y
CONFIG_CMD_DHCP=y
CONFIG_CMD_MII=y
CONFIG_CMD_PING=y
CONFIG_CMD_EXT2=y
CONFIG_CMD_EXT4=y
CONFIG_CMD_EXT4_WRITE=y
CONFIG_CMD_FAT=y
CONFIG_CMD_FS_GENERIC=y
CONFIG_OF_CONTROL=y
CONFIG_OF_PLATDATA=y
CONFIG_OF_LIST="rzn2h-dev"
CONFIG_MULTI_DTB_FIT_LZO=y
CONFIG_MULTI_DTB_FIT_USER_DEFINED_AREA=y
CONFIG_ENV_OVERWRITE=y
CONFIG_SYS_RELOC_GD_ENV_ADDR=y
CONFIG_REGMAP=y
CONFIG_SYSCON=y
CONFIG_CLK=y
CONFIG_RCAR_GPIO=y
CONFIG_DM_I2C=y
CONFIG_SYS_I2C_RCAR_IIC=y
CONFIG_SH_SDHI=y
CONFIG_BITBANGMII=y
CONFIG_PHY_MSCC=y
CONFIG_PHY_GIGE=y
CONFIG_NET_RANDOM_ETHADDR=y
CONFIG_DM_ETH=y
CONFIG_DM_ETH_PHY=y
CONFIG_DWC_ETH_QOS=y
CONFIG_DWC_ETH_QOS_RZT2H=y
CONFIG_RENESAS_RAVB=y
CONFIG_PCI=y
CONFIG_DM_PCI=y
CONFIG_PCI_RCAR_GEN3=y
CONFIG_DM_REGULATOR=y
CONFIG_DM_REGULATOR_FIXED=y
CONFIG_DM_REGULATOR_GPIO=y
CONFIG_SCIF_CONSOLE=y
CONFIG_TEE=y
CONFIG_OPTEE=y
CONFIG_USB=y
CONFIG_DM_USB=y
CONFIG_USB_XHCI_HCD=y
CONFIG_USB_EHCI_HCD=y
CONFIG_USB_EHCI_GENERIC=y
CONFIG_USB_STORAGE=y
CONFIG_OF_LIBFDT_OVERLAY=y
CONFIG_SMBIOS_MANUFACTURER=""
CONFIG_ENV_IS_IN_MMC=y
CONFIG_LMB_MAX_REGIONS=8
CONFIG_SYS_MALLOC_LEN=0x4000000
CONFIG_SYS_MMC_ENV_DEV=0
CONFIG_SYS_MMC_ENV_PART=2
CONFIG_SYS_I2C_RZG2L_RIIC=y
CONFIG_WDT=y
CONFIG_CMD_WDT=y
CONFIG_BOARD_LATE_INIT=y
CONFIG_SPI_FLASH=y
CONFIG_SPI_FLASH_BAR=y
CONFIG_SPI_FLASH_USE_4K_SECTORS=y
CONFIG_SPI=y
CONFIG_DM_SPI=y
CONFIG_SPI_FLASH_WINBOND=y
CONFIG_RENESAS_RPC_SPI=y
CONFIG_CMD_SF=y
CONFIG_CMD_SPI=y
CONFIG_SPI_FLASH_STMICRO=y
CONFIG_SPI_FLASH_MACRONIX=y
CONFIG_DM_SPI_FLASH=y
```

## configs/rzt2n-dev_defconfig
```kconfig
CONFIG_ARM=y
CONFIG_ARCH_CPU_INIT=y
CONFIG_ARCH_RENESAS=y
CONFIG_TEXT_BASE=0xC4000000
CONFIG_ENV_SECT_SIZE=0x20000
CONFIG_ENV_OFFSET=0x1E0000
CONFIG_DM_GPIO=y
CONFIG_DEFAULT_DEVICE_TREE="rzt2n-dev"
CONFIG_RZT2N=y
CONFIG_MULTI_DTB_FIT_UNCOMPRESS_SZ=0x8000
CONFIG_TARGET_RZT2N_DEV=y
CONFIG_TARGET_RZT2N_537_PIN_DEV=y
# CONFIG_SPL is not set
CONFIG_SYS_LOAD_ADDR=0xc8280000
CONFIG_PCI=y
CONFIG_FIT=y
CONFIG_SUPPORT_RAW_INITRD=y
CONFIG_DEFAULT_FDT_FILE="rzt2n-dev.dtb"
CONFIG_HUSH_PARSER=y
CONFIG_CMD_BOOTZ=y
CONFIG_CMD_GPIO=y
CONFIG_CMD_CLK=y
CONFIG_CMD_I2C=y
CONFIG_CMD_MMC=y
CONFIG_CMD_PCI=y
CONFIG_CMD_USB=y
CONFIG_CMD_DHCP=y
CONFIG_CMD_MII=y
CONFIG_CMD_PING=y
CONFIG_CMD_EXT2=y
CONFIG_CMD_EXT4=y
CONFIG_CMD_EXT4_WRITE=y
CONFIG_CMD_FAT=y
CONFIG_CMD_FS_GENERIC=y
CONFIG_CMD_NFS=y
CONFIG_OF_CONTROL=y
# CONFIG_OF_UPSTREAM is not set
CONFIG_ENV_OVERWRITE=y
CONFIG_ENV_IS_IN_SPI_FLASH=y
CONFIG_SYS_RELOC_GD_ENV_ADDR=y
CONFIG_VERSION_VARIABLE=y
CONFIG_REGMAP=y
CONFIG_SYSCON=y
CONFIG_CLK=y
CONFIG_RCAR_GPIO=y
CONFIG_RZT2N_GPIO=y
CONFIG_DM_I2C=y
CONFIG_SYS_I2C_RCAR_IIC=y
CONFIG_SH_SDHI=y
CONFIG_MTD=y
CONFIG_BITBANGMII=y
CONFIG_PHY_MSCC=y
CONFIG_DM_ETH_PHY=y
CONFIG_PHY_GIGE=y
CONFIG_DM_ETH=y
CONFIG_DWC_ETH_QOS=y
CONFIG_DWC_ETH_QOS_RZT2N=y
CONFIG_RENESAS_RAVB=y
CONFIG_NET_RANDOM_ETHADDR=y
CONFIG_PCI_RCAR_GEN3=y
CONFIG_PINCTRL_PFC_RZT2N=y
CONFIG_DM_REGULATOR=y
CONFIG_DM_REGULATOR_FIXED=y
CONFIG_DM_REGULATOR_GPIO=y
# CONFIG_SCIF_CONSOLE is not set
CONFIG_RSCI_CONSOLE=y
CONFIG_TEE=y
CONFIG_OPTEE=y
CONFIG_USB=y
CONFIG_DM_USB=y
CONFIG_USB_XHCI_HCD=y
CONFIG_USB_EHCI_HCD=y
CONFIG_USB_EHCI_GENERIC=y
CONFIG_USB_STORAGE=y
CONFIG_SPI_FLASH=y
CONFIG_SPI_FLASH_BAR=y
CONFIG_SPI_FLASH_USE_4K_SECTORS=y
CONFIG_SPI=y
CONFIG_DM_SPI=y
CONFIG_SPI_FLASH_WINBOND=y
CONFIG_RZ_XSPI=y
CONFIG_CMD_SF=y
CONFIG_CMD_SPI=y
CONFIG_SPI_FLASH_MACRONIX=y
CONFIG_DM_SPI_FLASH=y
CONFIG_CLK_RENESAS=y
CONFIG_CLK_R9A07G076=y
CONFIG_SYS_I2C_RZT2N_RIIC=y
```

## configs/rzv2h-evk-ver1_defconfig
```kconfig
CONFIG_USB_GADGET=y
CONFIG_USB_RENESAS_USBHS=y
CONFIG_USB_GADGET_DOWNLOAD=y
CONFIG_USB_FUNCTION_MASS_STORAGE=y
CONFIG_CMD_USB_MASS_STORAGE=y
CONFIG_ARM=y
CONFIG_ARCH_CPU_INIT=y
CONFIG_ARCH_RENESAS=y
CONFIG_OF_UPSTREAM=n
CONFIG_MTD=y
CONFIG_TEXT_BASE=0x50000000
CONFIG_ENV_SIZE=0x20000
CONFIG_ENV_OFFSET=0x001E0000
CONFIG_SYS_LOAD_ADDR=0x58000000
CONFIG_DM_GPIO=y
CONFIG_RCAR_GEN3=y
CONFIG_R9A09G057=y
CONFIG_TARGET_RZV2H_EVK_VER1=y
CONFIG_DEFAULT_DEVICE_TREE="rzv2h-evk-ver1"
CONFIG_SMBIOS_PRODUCT_NAME=""
CONFIG_SPL=n
CONFIG_FIT=y
CONFIG_SUPPORT_RAW_INITRD=y
CONFIG_DEFAULT_FDT_FILE="rzv2h-evk-ver1.dtb"
CONFIG_VERSION_VARIABLE=y
CONFIG_HUSH_PARSER=y
CONFIG_CMD_BOOTZ=y
CONFIG_CMD_GPIO=y
CONFIG_CMD_I2C=y
CONFIG_CMD_MMC=y
CONFIG_CMD_PCI=y
CONFIG_CMD_USB=y
CONFIG_CMD_DHCP=y
CONFIG_CMD_MII=y
CONFIG_CMD_PING=y
CONFIG_CMD_EXT2=y
CONFIG_CMD_EXT4=y
CONFIG_CMD_EXT4_WRITE=y
CONFIG_CMD_FAT=y
CONFIG_CMD_FS_GENERIC=y
CONFIG_OF_CONTROL=y
CONFIG_OF_PLATDATA=y
CONFIG_OF_LIST="rzv2h-evk-ver1"
CONFIG_MULTI_DTB_FIT_LZO=y
CONFIG_MULTI_DTB_FIT_USER_DEFINED_AREA=y
CONFIG_ENV_OVERWRITE=y
CONFIG_SYS_RELOC_GD_ENV_ADDR=y
CONFIG_REGMAP=y
CONFIG_SYSCON=y
CONFIG_CLK=y
CONFIG_CLK_RENESAS=y
CONFIG_CLK_R9A09G057=y
CONFIG_RCAR_GPIO=y
#CONFIG_PINCTRL_PFC_RZG2L=y
CONFIG_PINCTRL_PFC_RZV2H=y
CONFIG_RZV2H_GPIO=y
CONFIG_DM_I2C=y
CONFIG_SYS_I2C_RCAR_IIC=y
CONFIG_SH_SDHI=y
CONFIG_BITBANGMII=y
CONFIG_PHY_MICREL=y
CONFIG_PHY_MICREL_KSZ90X1=y
CONFIG_NET_RANDOM_ETHADDR=y
CONFIG_DM_ETH=y
CONFIG_DM_ETH_PHY=y
CONFIG_DWC_ETH_QOS=y
CONFIG_DWC_ETH_QOS_RZV2H=y
CONFIG_RENESAS_RAVB=y
CONFIG_PCI=y
CONFIG_DM_PCI=y
CONFIG_PCI_RCAR_GEN3=y
CONFIG_DM_REGULATOR=y
CONFIG_DM_REGULATOR_FIXED=y
CONFIG_DM_REGULATOR_GPIO=y
CONFIG_SCIF_CONSOLE=y
CONFIG_TEE=y
CONFIG_OPTEE=y
CONFIG_USB=y
CONFIG_USB_OTG=y
CONFIG_DM_USB=y
CONFIG_USB_XHCI_HCD=y
CONFIG_USB_EHCI_HCD=y
CONFIG_USB_EHCI_GENERIC=y
CONFIG_USB_STORAGE=y
CONFIG_OF_LIBFDT_OVERLAY=y
CONFIG_SMBIOS_MANUFACTURER=""
CONFIG_ENV_IS_IN_SPI_FLASH=y
CONFIG_SYS_I2C_RZG2L_RIIC=y
CONFIG_SPI_FLASH=y
CONFIG_SPI_FLASH_BAR=y
CONFIG_SPI_FLASH_USE_4K_SECTORS=y
CONFIG_SPI=y
CONFIG_DM_SPI=y
CONFIG_SPI_FLASH_WINBOND=y
CONFIG_RENESAS_RPC_SPI=y
CONFIG_CMD_SF=y
CONFIG_CMD_SPI=y
CONFIG_SPI_FLASH_STMICRO=y
CONFIG_DM_SPI_FLASH=y
CONFIG_ENV_SECT_SIZE=0x20000
#Core UEFI features:
CONFIG_BOOTM_EFI=y
CONFIG_CMD_BOOTEFI=y
CONFIG_CMD_NVEDIT_EFI=y
CONFIG_CMD_EFIDEBUG=y
CONFIG_CMD_BOOTEFI_HELLO=y
CONFIG_CMD_BOOTEFI_HELLO_COMPILE=y
CONFIG_CMD_BOOTEFI_SELFTEST=y
CONFIG_CMD_GPT=y
CONFIG_EFI_PARTITION=y
CONFIG_EFI_LOADER=y
CONFIG_EFI_DEVICE_PATH_TO_TEXT=y
CONFIG_EFI_UNICODE_COLLATION_PROTOCOL2=y
CONFIG_EFI_UNICODE_CAPITALIZATION=y
CONFIG_EFI_HAVE_RUNTIME_RESET=y
CONFIG_CMD_EFI_VARIABLE_FILE_STORE=y
#Real Time Clock (RTC) support:
CONFIG_DM_RTC=y
CONFIG_EFI_GET_TIME=y
CONFIG_EFI_SET_TIME=y
CONFIG_RTC_EMULATION=y
#update firmware:
CONFIG_CMD_DFU=y
CONFIG_FLASH_CFI_MTD=y
CONFIG_EFI_CAPSULE_FIRMWARE_FIT=y
CONFIG_EFI_CAPSULE_FIRMWARE_MANAGEMENT=y
CONFIG_EFI_CAPSULE_FIRMWARE=y
CONFIG_EFI_CAPSULE_FIRMWARE_RAW=y
CONFIG_EFI_CAPSULE_FMP_HEADER=y
# to enable partitions and filesystems support:
CONFIG_FAT_WRITE=y
CONFIG_FS_FAT=y
CONFIG_CMD_PART=y
CONFIG_PARTITIONS=y
CONFIG_DOS_PARTITION=y
CONFIG_ISO_PARTITION=y
CONFIG_PARTITION_UUIDS=y
#Device Firmware update:
CONFIG_OF_LIBFDT=y
#CONFIG_DISTRO_DEFAULTS=y
CONFIG_CMD_RTC=y
CONFIG_EFI_RUNTIME_UPDATE_CAPSULE=y
CONFIG_EFI_HAVE_CAPSULE_SUPPORT=y
CONFIG_EFI_CAPSULE_ON_DISK=y
CONFIG_SPL_DFU=y
CONFIG_DM_MTD=y
CONFIG_DFU_MTD=y
CONFIG_SPL_DFU_MTD=y
CONFIG_DFU_SF=y
CONFIG_DFU_OVER_USB=y
CONFIG_DFU=y
CONFIG_DFU_MMC=y
CONFIG_DFU_NAND=y
CONFIG_DFU_RAM=y
CONFIG_DFU_SF_PART=y
CONFIG_DFU_TIMEOUT=y
CONFIG_DFU_OVER_TFTP=y
CONFIG_DFU_TFTP=y
#generate capsule files
#CONFIG_EFI_CAPSULE_AUTHENTICATE=y
CONFIG_EFI_SECURE_BOOT=y
CONFIG_EFI_SIGNATURE_SUPPORT=y
CONFIG_RSA=y
CONFIG_RSA_VERIFY=y
CONFIG_RSA_VERIFY_WITH_PKEY=y
CONFIG_IMAGE_SIGN_INFO=y
CONFIG_RSA_SOFTWARE_EXP=y
CONFIG_ASYMMETRIC_KEY_TYPE=y
CONFIG_ASYMMETRIC_PUBLIC_KEY_SUBTYPE=y
CONFIG_RSA_PUBLIC_KEY_PARSER=y
CONFIG_X509_CERTIFICATE_PARSER=y
CONFIG_PKCS7_MESSAGE_PARSER=y
CONFIG_PKCS7_VERIFY=y
CONFIG_HASH=y
CONFIG_SHA1=y
CONFIG_SHA256=y
CONFIG_SHA512=y
CONFIG_SHA384=y
CONFIG_MD5=y
CONFIG_CRC32=y
#EFI System Resource Table (ESRT)
CONFIG_EFI_ESRT=y
#Secure boot
CONFIG_FIT_SIGNATURE=y

CONFIG_PROT_TCP=y
CONFIG_PROT_TCP_SACK=y
CONFIG_CMD_WGET=y
```
