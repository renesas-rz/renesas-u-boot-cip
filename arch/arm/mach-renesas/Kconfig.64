## arch/arm/mach-renesas/Kconfig.64
```kconfig
if RCAR_64

config SYS_MALLOC_F_LEN
	default 0x8000 if RCAR_64

config OF_LIBFDT_OVERLAY
	default y if RCAR_64

source "arch/arm/mach-renesas/Kconfig.rcar3"
source "arch/arm/mach-renesas/Kconfig.rcar4"

endif
if RZ_V2M

choice
       prompt "Select Target SoC"

config R9A09G011GBG
       bool "Renesas RZV2M r9a09g011gbg"

config R9A09G055MA3GBG
       bool "Renesas RZV2MA r9a09g055ma3gbg"

endchoice


choice
       prompt "Renesus ARM64 (not Gen3) SoCs board select"
       optional

config TARGET_RZV2M
       bool "RZV2M board"
       help
          Support for Renesas RZV2M platform

config TARGET_RZV2MA
       bool "RZV2MA EVK board"
       help
          Support for Renesas RZV2MA platform

endchoice

config SYS_SOC
       default "rmobile"

source "board/renesas/rzv2m-dev/Kconfig"
source "board/renesas/rzv2ma-dev/Kconfig"

endif
```

## arch/arm/mach-rmobile/Kconfig.64
```kconfig
if RCAR_GEN3

menu "Select Target SoC"

config R8A774A1
        bool "Renesas SoC R8A774A1"

config R8A774B1
	bool "Renesas SoC R8A774B1"

config R8A774C0
	bool "Renesas SoC R8A774C0"

config R8A774E1
	bool "Renesas SoC R8A774E1"

config R8A7795
	bool "Renesas SoC R8A7795"
	imply CLK_R8A7795
	imply PINCTRL_PFC_R8A7795

config R8A7796
	bool "Renesas SoC R8A7796"
	imply CLK_R8A7796
	imply PINCTRL_PFC_R8A7796

config R8A77965
	bool "Renesas SoC R8A77965"
	imply CLK_R8A77965
	imply PINCTRL_PFC_R8A77965

config R8A77970
	bool "Renesas SoC R8A77970"
	imply CLK_R8A77970
	imply PINCTRL_PFC_R8A77970

config R8A77980
	bool "Renesas SoC R8A77980"
	imply CLK_R8A77980
	imply PINCTRL_PFC_R8A77980

config R8A77990
	bool "Renesas SoC R8A77990"
	imply CLK_R8A77990
	imply PINCTRL_PFC_R8A77990

config R8A77995
	bool "Renesas SoC R8A77995"
	imply CLK_R8A77995
	imply PINCTRL_PFC_R8A77995

endmenu

choice
	prompt "Renesas ARM64 SoCs board select"
	optional

config TARGET_BEACON_RZG2M
	bool "Beacon EmbeddedWorks RZ/G2M Dev Kit"
	select R8A774A1
	select PINCTRL_PFC_R8A774A1

config TARGET_HIHOPE_RZG2M
	bool "HiHope RZ/G2M board"
	select PINCTRL_PFC_R8A774A1
	help
          Support for RZG2M HiHope platform

config TARGET_HIHOPE_RZG2N
	bool "HiHope RZ/G2N board"
	select PINCTRL_PFC_R8A774B1
	help
          Support for RZG2N HiHope platform

config TARGET_EK874
	bool "EK874 board"
	select PINCTRL_PFC_R8A774C0
	help
          Support for Renesas RZ/G2E EK874 platform

config TARGET_HIHOPE_RZG2H
	bool "HiHope RZ/G2H board"
	select PINCTRL_PFC_R8A774E1
	help
          Support for RZG2H HiHope platform

config TARGET_CONDOR
	bool "Condor board"
	imply R8A77980
	help
          Support for Renesas R-Car Gen3 Condor platform

config TARGET_DRAAK
	bool "Draak board"
	imply R8A77995
	help
          Support for Renesas R-Car Gen3 Draak platform

config TARGET_EAGLE
	bool "Eagle board"
	imply R8A77970
	help
          Support for Renesas R-Car Gen3 Eagle platform

config TARGET_EBISU
	bool "Ebisu board"
	imply R8A77990
	help
          Support for Renesas R-Car Gen3 Ebisu platform

config TARGET_SALVATOR_X
	bool "Salvator-X board"
	imply R8A7795
	imply R8A7796
	imply R8A77965
	imply SYS_MALLOC_F
	imply MULTI_DTB_FIT
	imply MULTI_DTB_FIT_USER_DEFINED_AREA
	help
          Support for Renesas R-Car Gen3 platform

config TARGET_ULCB
	bool "ULCB board"
	imply R8A7795
	imply R8A7796
	imply R8A77965
	imply SYS_MALLOC_F
	imply MULTI_DTB_FIT
	imply MULTI_DTB_FIT_USER_DEFINED_AREA
	help
          Support for Renesas R-Car Gen3 ULCB platform

endchoice

config SYS_SOC
	default "rmobile"

source "board/renesas/condor/Kconfig"
source "board/renesas/draak/Kconfig"
source "board/renesas/eagle/Kconfig"
source "board/renesas/ebisu/Kconfig"
source "board/renesas/salvator-x/Kconfig"
source "board/renesas/ulcb/Kconfig"
source "board/beacon/beacon-rzg2m/Kconfig"
source "board/renesas/hihope-rzg2m/Kconfig"
source "board/renesas/hihope-rzg2n/Kconfig"
source "board/renesas/hihope-rzg2h/Kconfig"
source "board/renesas/ek874/Kconfig"


config MULTI_DTB_FIT_UNCOMPRESS_SZ
	default 0x80000 if TARGET_SALVATOR_X
	default 0x80000 if TARGET_ULCB

config MULTI_DTB_FIT_USER_DEF_ADDR
	default 0x49000000 if TARGET_SALVATOR_X
	default 0x49000000 if TARGET_ULCB

config SYS_MALLOC_F_LEN
	default 0x8000 if RCAR_GEN3

endif
```

## board/renesas/ek874/Kconfig
```kconfig
if TARGET_EK874

config SYS_SOC
	default "rmobile"

config SYS_BOARD
	default "ek874"

config SYS_VENDOR
	default "renesas"

config SYS_CONFIG_NAME
	default "ek874"

endif
```

## board/renesas/hihope-rzg2h/Kconfig
```kconfig
if TARGET_HIHOPE_RZG2H

config SYS_SOC
	default "rmobile"

config SYS_BOARD
	default "hihope-rzg2h"

config SYS_VENDOR
	default "renesas"

config SYS_CONFIG_NAME
	default "hihope-rzg2h"

endif
```

## board/renesas/hihope-rzg2m/Kconfig
```kconfig
if TARGET_HIHOPE_RZG2M

config SYS_SOC
	default "rmobile"

config SYS_BOARD
	default "hihope-rzg2m"

config SYS_VENDOR
	default "renesas"

config SYS_CONFIG_NAME
	default "hihope-rzg2m"

endif
```

## board/renesas/hihope-rzg2n/Kconfig
```kconfig
if TARGET_HIHOPE_RZG2N

config SYS_SOC
	default "rmobile"

config SYS_BOARD
	default "hihope-rzg2n"

config SYS_VENDOR
	default "renesas"

config SYS_CONFIG_NAME
	default "hihope-rzg2n"

endif
```

## board/renesas/rzf-dev/Kconfig
```kconfig
if TARGET_RZF_DEV

config SYS_CPU
	default "ax25"

config SYS_BOARD
	default "rzf-dev"

config SYS_VENDOR
	default "renesas"

config SYS_SOC
	default "rzmpu"

config SYS_CONFIG_NAME
	default "rzf-dev"

config ENV_SIZE
	default 0x2000 if ENV_IS_IN_SPI_FLASH

config ENV_OFFSET
	default 0x140000 if ENV_IS_IN_SPI_FLASH

config SPL_TEXT_BASE
	default 0x00012000

config SPL_OPENSBI_LOAD_ADDR
	default 0x20100000

config BOARD_SPECIFIC_OPTIONS # dummy
	def_bool y
	select RISCV_NDS
	select SUPPORT_SPL
	imply SMP
	imply SPL_RAM_SUPPORT
	imply SPL_RAM_DEVICE


choice
	prompt "DDR type select"
	default RZF_DDR_C_011_D4_01_1

config RZF_DDR_C_010_D3_02_2
	bool "param_mc_C-010_D3-02-2"

config RZF_DDR_C_010_D4_01_1
	bool "param_mc_C-010_D4-01-1"

config RZF_DDR_C_010_D4_01_2
	bool "param_mc_C-010_D4-01-2"

config RZF_DDR_C_011_D4_01_1
	bool "param_mc_C-011_D4-01-1"

endchoice

choice
	prompt "DDR type select"
	default RZF_DDR_SWIZZLE_T3CL

config RZF_DDR_SWIZZLE_T1BC
	bool param_swizzle_T1bc"

config RZF_DDR_SWIZZLE_T1C
	bool "param_swizzle_T1c"

config RZF_DDR_SWIZZLE_T2C
	bool "param_swizzle_T2c"

config RZF_DDR_SWIZZLE_T3CL
	bool "param_swizzle_T3cl"

endchoice

config RZF_DDR_PLL4
	int "DDR PLL clock"
	default 1600

config DEBUG_RZF_FPGA
	bool "FPGA DEBUG option"

endif
```

## board/renesas/rzg2l-dev/Kconfig
```kconfig
if TARGET_RZG2L_DEV

config SYS_SOC
	default "rmobile"

config SYS_BOARD
	default "rzg2l-dev"

config SYS_VENDOR
	default "renesas"

config SYS_CONFIG_NAME
	default "rzg2l-dev"

endif
```

## board/renesas/rzg2lc-dev/Kconfig
```kconfig
if TARGET_RZG2LC_DEV

config SYS_SOC
	default "rmobile"

config SYS_BOARD
	default "rzg2lc-dev"

config SYS_VENDOR
	default "renesas"

config SYS_CONFIG_NAME
	default "rzg2lc-dev"

endif
```

## board/renesas/rzg3e-dev/Kconfig
```kconfig
if TARGET_RZG3E_DEV

config SYS_SOC
	default "renesas"

config SYS_BOARD
	default "rzg3e-dev"

config SYS_VENDOR
	default "renesas"

config SYS_CONFIG_NAME
	default "rzg3e-dev"

endif

if TARGET_SMARC_RZG3E

config SYS_SOC
	default "renesas"

config SYS_BOARD
	default "rzg3e-dev"

config SYS_VENDOR
	default "renesas"

config SYS_CONFIG_NAME
	default "rzg3e-dev"

endif
```

## board/renesas/rzg3s-dev/Kconfig
```kconfig
if TARGET_RZG3S_DEV

config SYS_SOC
	default "rmobile"

config SYS_BOARD
	default "rzg3s-dev"

config SYS_VENDOR
	default "renesas"

config SYS_CONFIG_NAME
	default "rzg3s-dev"

endif

if TARGET_SMARC_RZG3S

config SYS_SOC
	default "rmobile"

config SYS_BOARD
	default "rzg3s-dev"

config SYS_VENDOR
	default "renesas"

config SYS_CONFIG_NAME
	default "smarc-rzg3s"

endif
```

## board/renesas/rzv2m-dev/Kconfig
```kconfig
if TARGET_RZV2M

config SYS_SOC
	default "rmobile"

config SYS_BOARD
	default "rzv2m-dev"

config SYS_VENDOR
	default "renesas"

config SYS_CONFIG_NAME
	default "rzv2m"

endif
```

## board/renesas/rzv2ma-dev/Kconfig
```kconfig
if TARGET_RZV2MA

config SYS_SOC
	default "rmobile"

config SYS_BOARD
	default "rzv2ma-dev"

config SYS_VENDOR
	default "renesas"

config SYS_CONFIG_NAME
	default "rzv2ma"

endif
```

## configs/r9a09g055ma3gbg_rzv2ma_defconfig
```kconfig
CONFIG_ARM=y
CONFIG_ARCH_CPU_INIT=y
CONFIG_ARCH_RMOBILE=y
CONFIG_SYS_TEXT_BASE=0x08000000
CONFIG_ENV_SIZE=0x20000
CONFIG_ENV_OFFSET=0xFFFE0000
CONFIG_SYS_MALLOC_F_LEN=0x2000
#CONFIG_RCAR_GEN3=y
CONFIG_DM_GPIO=y
CONFIG_RZ_V2M=y
CONFIG_R9A09G055MA3GBG=y
CONFIG_TARGET_RZV2MA=y
CONFIG_ARCH_MISC_INIT=n
CONFIG_DEFAULT_DEVICE_TREE="r9a09g055ma3gbg-rzv2ma-u-boot"
CONFIG_SMBIOS_PRODUCT_NAME=""
CONFIG_SPL=n
CONFIG_FIT=y
# CONFIG_ARCH_FIXUP_FDT_MEMORY is not set
CONFIG_BOOTDELAY=3
CONFIG_USE_BOOTARGS=y
CONFIG_BOOTARGS="root=/dev/nfs rw nfsroot=192.168.1.10:/nfs/rzv2m,nfsvers=3 ip=192.168.1.11:192.168.1.10::255.255.255.0:rzv2m:eth0"
CONFIG_SUPPORT_RAW_INITRD=y
CONFIG_OF_BOARD_SETUP=n
CONFIG_DEFAULT_FDT_FILE="r9a09g055ma3gbg-evaluation-board.dtb"
CONFIG_VERSION_VARIABLE=y
CONFIG_HUSH_PARSER=y
CONFIG_CMD_BOOTZ=y
CONFIG_CMD_GPIO=y
CONFIG_CMD_I2C=y
CONFIG_CMD_MMC=y
CONFIG_CMD_USB=y
CONFIG_CMD_DHCP=y
CONFIG_CMD_MII=y
CONFIG_CMD_PING=y
CONFIG_CMD_CACHE=y
CONFIG_CMD_EXT2=y
CONFIG_CMD_EXT4=y
CONFIG_CMD_EXT4_WRITE=y
CONFIG_CMD_FAT=y
CONFIG_CMD_FS_GENERIC=y
CONFIG_CMD_ECC=n
CONFIG_CMD_EVK=y
CONFIG_OF_CONTROL=y
CONFIG_OF_PLATDATA=y
CONFIG_OF_LIST="r9a09g055ma3gbg-rzv2ma-u-boot"
#CONFIG_ENV_IS_IN_FAT=y
#CONFIG_ENV_FAT_INTERFACE="mmc"
#CONFIG_ENV_FAT_DEVICE_AND_PART="0:1"
#CONFIG_ENV_FAT_FILE="rzv2ma-u-boot.env"
CONFIG_MULTI_DTB_FIT_LZO=y
CONFIG_MULTI_DTB_FIT_USER_DEFINED_AREA=y
CONFIG_ENV_OVERWRITE=y
CONFIG_SYS_RELOC_GD_ENV_ADDR=y 
CONFIG_REGMAP=y
CONFIG_SYSCON=y
CONFIG_BLK=y
CONFIG_CLK=y
#CONFIG_CLK_RENESAS=y
#CONFIG_RCAR_GPIO=y
CONFIG_DM_I2C=y
CONFIG_SYS_I2C_RCAR_IIC=y
CONFIG_DM_MMC=y
CONFIG_MMC_IO_VOLTAGE=y
CONFIG_MMC_UHS_SUPPORT=y
CONFIG_MMC_HS200_SUPPORT=y
CONFIG_RENESAS_SDHI=y
CONFIG_PHY_REALTEK=y
CONFIG_BITBANGMII=y
CONFIG_DM_ETH=y
CONFIG_RENESAS_RAVB=y
CONFIG_PINCTRL=y
CONFIG_PINCONF=y
CONFIG_PINCTRL_PFC=n
CONFIG_DM_REGULATOR=n
CONFIG_DM_REGULATOR_FIXED=n
CONFIG_DM_REGULATOR_GPIO=n
#CONFIG_SCIF_CONSOLE=y
CONFIG_DM_SERIAL=n
CONFIG_RZV2M_SERIAL=y
CONFIG_USB=y
CONFIG_DM_USB=y
CONFIG_USB_XHCI_HCD=y
CONFIG_USB_EHCI_HCD=y
CONFIG_USB_EHCI_GENERIC=y
CONFIG_USB_STORAGE=y
CONFIG_OF_LIBFDT_OVERLAY=y
CONFIG_SMBIOS_MANUFACTURER=""
CONFIG_ENV_IS_IN_MMC=y
CONFIG_PRAM=1
CONFIG_SYS_CONFIG_NAME="rzv2ma"
CONFIG_SUPPORT_EMMC_BOOT=y
```

## configs/rzf-dev_spl_defconfig
```kconfig
CONFIG_RISCV=y
#CONFIG_ARM=y
#CONFIG_ARCH_CPU_INIT=y
#CONFIG_ARCH_RMOBILE=y
CONFIG_SYS_TEXT_BASE=0x50000000
CONFIG_ENV_SIZE=0x20000
CONFIG_ENV_OFFSET=0xFFFE0000
CONFIG_DM_GPIO=y
CONFIG_RCAR_GEN3=y
CONFIG_R9A07G044L=y
CONFIG_TARGET_RZF_DEV=y
CONFIG_DEFAULT_DEVICE_TREE="rzf-dev"
CONFIG_SMBIOS_PRODUCT_NAME=""
CONFIG_SPL=y
CONFIG_FIT=y
CONFIG_USE_BOOTARGS=y
CONFIG_BOOTARGS="root=/dev/nfs rw nfsroot=192.168.0.1:/export/rfs ip=192.168.0.20"
CONFIG_SUPPORT_RAW_INITRD=y
CONFIG_DEFAULT_FDT_FILE="rzf-dev.dtb"
CONFIG_VERSION_VARIABLE=y
CONFIG_HUSH_PARSER=y
CONFIG_CMD_BOOTZ=y
CONFIG_CMD_GPIO=y
CONFIG_CMD_I2C=y
CONFIG_CMD_MMC=y
CONFIG_CMD_PCI=y
CONFIG_CMD_USB=y
CONFIG_CMD_DHCP=y
CONFIG_CMD_MII=y
CONFIG_CMD_PING=y
CONFIG_CMD_EXT2=y
CONFIG_CMD_EXT4=y
CONFIG_CMD_EXT4_WRITE=y
CONFIG_CMD_FAT=y
CONFIG_CMD_FS_GENERIC=y
CONFIG_OF_CONTROL=y
#CONFIG_OF_PLATDATA=y
CONFIG_OF_LIST="rzf-dev"
CONFIG_MULTI_DTB_FIT_LZO=y
CONFIG_MULTI_DTB_FIT_USER_DEFINED_AREA=y
CONFIG_ENV_OVERWRITE=y
CONFIG_SYS_RELOC_GD_ENV_ADDR=y
CONFIG_REGMAP=y
CONFIG_SYSCON=y
CONFIG_CLK=y
CONFIG_CLK_RENESAS=y
CONFIG_CLK_R9A07G044L=y
CONFIG_RCAR_GPIO=y
CONFIG_PINCTRL_PFC_RZG2L=y
CONFIG_RZG2L_GPIO=y
CONFIG_DM_I2C=y
CONFIG_SYS_I2C_RCAR_IIC=y
CONFIG_SH_SDHI=y
########CONFIG_BITBANGMII=y
CONFIG_PHY_MICREL=y
CONFIG_PHY_MICREL_KSZ90X1=y
CONFIG_DM_ETH=y
CONFIG_RENESAS_RAVB=y
CONFIG_PCI=y
CONFIG_DM_PCI=y
CONFIG_PCI_RCAR_GEN3=y
CONFIG_DM_REGULATOR=y
CONFIG_DM_REGULATOR_FIXED=y
CONFIG_DM_REGULATOR_GPIO=y
CONFIG_SCIF_CONSOLE=y
CONFIG_TEE=y
CONFIG_OPTEE=y
CONFIG_USB=y
CONFIG_DM_USB=y
########CONFIG_USB_XHCI_HCD=y
CONFIG_USB_EHCI_HCD=y
CONFIG_USB_EHCI_GENERIC=y
CONFIG_USB_STORAGE=y
CONFIG_OF_LIBFDT_OVERLAY=y
CONFIG_SMBIOS_MANUFACTURER=""
CONFIG_ENV_IS_IN_MMC=y
#
CONFIG_ARCH_RV64I=y
CONFIG_RISCV_SMODE=y
#CONFIG_CACHE=y
#CONFIG_RISCV_NDS_CACHE=y
#CONFIG_V5L2_CACHE=y
CONFIG_BOARD_EARLY_INIT_F=y
#CONFIG_OF_BOARD=y
CONFIG_OF_SEPARATE=y
CONFIG_SPL_BLK=y
CONFIG_SPL_CACHE=y
CONFIG_SPL_DM_MMC=y
CONFIG_SPL_FIT=y
CONFIG_SPL_LOAD_FIT=y
CONFIG_SPL_LOAD_FIT_ADDRESS=0x20020000
CONFIG_SPL_OF_CONTROL=y
CONFIG_SPL_OF_LIST="rzv-dev"
CONFIG_SPL_SEPARATE_BSS=y
CONFIG_SPL_SMP=n
CONFIG_SPL_TEXT_BASE=0x00012000
CONFIG_MMC=y
CONFIG_XIP=y
#CONFIG_CMD_IMLS=y
CONFIG_CMD_SBI=y
CONFIG_DISTRO_DEFAULTS=y
CONFIG_ENV_IS_IN_SPI_FLASH=y
CONFIG_HAVE_BLOCK_DEVICE=y
CONFIG_BAUDRATE=115200
CONFIG_DISPLAY_BOARDINFO=y
CONFIG_DISPLAY_CPUINFO=y
CONFIG_SPL_FRAMEWORK_BOARD_INIT_F=n
CONFIG_DEBUG_RZG2L_FPGA=y
CONFIG_DEBUG_RZG2L_FPGA=0x00030000
```

## drivers/ddr/renesas/Kconfig
```kconfig
if TARGET_RZF_DEV || TARGET_SMARC_RZF

choice
	prompt "DDR type select"
	default RZF_DDR_SWIZZLE_T3CL

config RZF_DDR_SWIZZLE_T1BC
	bool "param_swizzle_T1bc"

config RZF_DDR_SWIZZLE_T1C
	bool "param_swizzle_T1c"

config RZF_DDR_SWIZZLE_T2C
	bool "param_swizzle_T2c"

config RZF_DDR_SWIZZLE_T3BC
	bool "param_swizzle_T3bc"

config RZF_DDR_SWIZZLE_T3BCUD
	bool "param_swizzle_T3bcud"

config RZF_DDR_SWIZZLE_T3BCUD2
	bool "param_swizzle_T3bcud2"

config RZF_DDR_SWIZZLE_T3BCUL
	bool "param_swizzle_T3bcul"

config RZF_DDR_SWIZZLE_T3CL
	bool "param_swizzle_T3cl"
endchoice

config RZF_DDR_PLL4
	int "DDR clock"
	default 1600

config RZF_DDR_SIZE
	hex "DDR RAM size"
	default 0x40000000

config RZF_DDR_ECC
	bool "DDR ECC support for rzfive"
	default n

choice
	prompt "Select DDR ECC support"
	depends on RZF_DDR_ECC
	default RZF_DDR_ECC_ENABLE

config RZF_DDR_ECC_ENABLE
	bool "Enable DDR ECC only"

config RZF_DDR_ECC_DETECT
	bool "Add error detection support"

config RZF_DDR_ECC_DETECT_CORRECT
	bool "Add error detection and auto correct support"
endchoice

endif
```
